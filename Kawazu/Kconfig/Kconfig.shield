## Kawazu/Kconfig/Kconfig.shield
```kconfig
osource "C:/Users/dqmag/SlimeVR-Tracker-nRF/boards/shields/*/Kconfig.shield"
osource "C:/ncs/v3.2.0/nrf/boards/shields/*/Kconfig.shield"
```

## Kawazu/SlimeVR-Tracker-nRF/Kconfig/Kconfig.shield.defconfig
```kconfig
osource "C:/Users/dqmag/SlimeVR-Tracker-nRF/boards/shields/*/Kconfig.defconfig"
osource "C:/ncs/v3.2.0/nrf/boards/shields/*/Kconfig.defconfig"
```

## boards/nekumori/sakuranrf/board.yml
```yaml
# Copyright (c) 2024 Nordic Semiconductor ASA
# SPDX-License-Identifier: Apache-2.0

board:
  name: sakuranrf_uf2
  vendor: nekumori
  socs:
    - name: nrf52833
      variants:
      - name: 'chrysalis'
```
