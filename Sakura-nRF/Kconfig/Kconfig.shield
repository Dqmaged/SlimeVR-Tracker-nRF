## Sakura-nRF/Kconfig/Kconfig.shield
```kconfig
osource "F:/nRF-Firmware-DqEdit/SlimeVR-Tracker-nRF/boards/shields/*/Kconfig.shield"
osource "C:/ncs/v3.2.0/nrf/boards/shields/*/Kconfig.shield"
```

## Sakura-nRF/Kconfig/boards/Kconfig
```kconfig
# Load Zephyr board Kconfig descriptions.
osource "F:/nRF-Firmware-DqEdit/SlimeVR-Tracker-nRF/boards/nekumori/sakuranrf/Kconfig"
```

## Sakura-nRF/SlimeVR-Tracker-nRF/Kconfig/Kconfig.shield.defconfig
```kconfig
osource "F:/nRF-Firmware-DqEdit/SlimeVR-Tracker-nRF/boards/shields/*/Kconfig.defconfig"
osource "C:/ncs/v3.2.0/nrf/boards/shields/*/Kconfig.defconfig"
```

## Sakura-nRF/SlimeVR-Tracker-nRF/Kconfig/boards/Kconfig.defconfig
```kconfig
# Load Zephyr board defconfig descriptions.
osource "F:/nRF-Firmware-DqEdit/SlimeVR-Tracker-nRF/boards/nekumori/sakuranrf/Kconfig.defconfig"
```
